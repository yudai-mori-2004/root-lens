## document/hardware/ego-oscar-split/firmware/main/Kconfig.projbuild
```kconfig
menu "RootLens Ego camera pipeline"

config EXAMPLE_M2M_MODE_DECODE
    bool "Decode Motion JPEG frames before H.264 encoding"
    default y
    help
        Enables the Espressif video example's USB-camera-to-JPEG-decoder path.
        RootLens always requires this because the stereo camera outputs Motion JPEG.

endmenu
```

## hardware/ego-oscar-split/firmware/sdkconfig.defaults
```kconfig
CONFIG_IDF_EXPERIMENTAL_FEATURES=y
CONFIG_SPIRAM=y
CONFIG_SPIRAM_SPEED_200M=y
CONFIG_ESP_MAIN_TASK_STACK_SIZE=8192
CONFIG_VFS_MAX_COUNT=16
CONFIG_PARTITION_TABLE_CUSTOM=y
CONFIG_PARTITION_TABLE_CUSTOM_FILENAME="partitions.csv"
CONFIG_ESPTOOLPY_FLASHSIZE_16MB=y

CONFIG_ESP_VIDEO_ENABLE_USB_UVC_VIDEO_DEVICE=y
CONFIG_ESP_VIDEO_ENABLE_HW_JPEG_DEC_VIDEO_DEVICE=y
CONFIG_ESP_VIDEO_ENABLE_HW_H264_VIDEO_DEVICE=y
CONFIG_EXAMPLE_ENABLE_USB_UVC_CAM_SENSOR=y
CONFIG_EXAMPLE_USB_UVC_DEVICES_NUM=1
CONFIG_EXAMPLE_USB_UVC_TASK_STACK_SIZE=8192
CONFIG_EXAMPLE_USB_LIB_TASK_STACK_SIZE=8192
CONFIG_USB_HOST_CONTROL_TRANSFER_MAX_SIZE=1024
CONFIG_EXAMPLE_M2M_MODE_DECODE=y

CONFIG_ESP_HOSTED=y
CONFIG_ESP_HOSTED_HOST_FEAT_RPC=y
CONFIG_ESP_HOSTED_HOST_FEAT_RPC_EXT_V2=y
CONFIG_ESP_HOSTED_HOST_FEAT_SYSTEM=y
CONFIG_ESP_HOSTED_HOST_FEAT_WIFI=y
CONFIG_ESP_HOSTED_CP_TARGET_ESP32C6=y
CONFIG_ESP_HOSTED_HOST_TRANSPORT_BUS_SDIO=y
CONFIG_ESP_HOSTED_SDIO_SLOT_1=y
CONFIG_ESP_HOSTED_HOST_SDIO_BUS_WIDTH_4=y
CONFIG_ESP_HOSTED_HOST_SDIO_RX_STREAMING_MODE=y
CONFIG_ESP_HOSTED_HOST_SDIO_PIN_CLK=43
CONFIG_ESP_HOSTED_HOST_SDIO_PIN_CMD=44
CONFIG_ESP_HOSTED_HOST_SDIO_PIN_D0=45
CONFIG_ESP_HOSTED_HOST_SDIO_PIN_D1=46
CONFIG_ESP_HOSTED_HOST_SDIO_PIN_D2=47
CONFIG_ESP_HOSTED_HOST_SDIO_PIN_D3=48
CONFIG_ESP_HOSTED_HOST_RESET_GPIO=42
```
